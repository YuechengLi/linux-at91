/*
 * at91rm9200ek.dts - Device Tree file for Atmel AT91RM9200 evaluation kit with
 *                    an MMC slot
 *
 *  Copyright (C) 2013 Boris BREZILLON <b.brezillon@overkiz.com>
 *
 * Licensed under GPLv2 only
 */
/dts-v1/;
#include "at91rm9200ek.dts"

/ {
	model = "Atmel AT91RM9200 evaluation kit with MMC slot";
	compatible = "atmel,at91rm9200ek-mmc", "atmel,at91rm9200ek", "atmel,at91rm9200";

	ahb {
		apb {
			mmc0: mmc@fffb4000 {
				status = "okay";
			};
		};
	};
};
