## Documentation/devicetree/bindings/interrupt-controller/atmel,aic.txt
```
* Advanced Interrupt Controller (AIC)

Required properties:
- compatible: Should be "atmel,<chip>-aic"
- interrupt-controller: Identifies the node as an interrupt controller.
- interrupt-parent: For single AIC system, it is an empty property.
- #interrupt-cells: The number of cells to define the interrupts. It should be 3.
  The first cell is the IRQ number (aka "Peripheral IDentifier" on datasheet).
  The second cell is used to specify flags:
    bits[3:0] trigger type and level flags:
      1 = low-to-high edge triggered.
      2 = high-to-low edge triggered.
      4 = active high level-sensitive.
      8 = active low level-sensitive.
      Valid combinations are 1, 2, 3, 4, 8.
      Default flag for internal sources should be set to 4 (active high).
  The third cell is used to specify the irq priority from 0 (lowest) to 7
  (highest).
- reg: Should contain AIC registers location and length
- #address-cells: Shall be 1 (used to represent the irq line id when defining
  irq-mux nodes).
- #size-cells: Shall be 0.
- atmel,external-irqs: u32 array of external irqs.

Optional properties:
- atmel,irq-mapping: u32 mask array representing the available irqs:
    e.i. : atmel,irq-mapping = <0xffff1fff> => irqs 13 to 15 are unavailables

Optional children nodes:
- irq-mux nodes:
  Required properties:
  * compatible: Should be "atmel,aic-mux"

  Optional children nodes:
  * muxed irq entries:
      Required properties:
      + compatible: Shall be
        "atmel,aic-mux-1reg-irq": irq enable/disable/retrieve-status is done by
        setting/clearing/reading flags in a specific register
        or
        "atmel,aic-mux-3reg-irq": irq enable/disable/retrieve-status is done
        by writing/reading flags in specific enable/disable/mask registers
      + atmel,aic-mux-irq-reg: represent the disable or mode register used to
        disable the given muxed irq.
        The first cell is a phandle to the device node owning the muxed irq.
	The second cell is the iomem range index.
        The third cell is the disable or mode register offset.
	The fourth cell is the mask used to disable the irq.

Examples:
	/*
	 * AIC
	 */
	aic: interrupt-controller@fffff000 {
		compatible = "atmel,at91rm9200-aic";
		interrupt-controller;
		interrupt-parent;
		#interrupt-cells = <3>;
		reg = <0xfffff000 0x200>;
		#address-cells = <1>;
		#size-cells = <0>;

		sysc_irq_mux: irq-mux@1 {
			compatible = "atmel,aic-mux";
			reg = <1>;

			dbgu_irq {
				compatible = "atmel,aic-mux-3reg-irq";
				atmel,aic-mux-irq-reg = <&dbgu 0 0xc 0xc0001afb>;
			};

			pmc_irq {
				compatible = "atmel,aic-mux-3reg-irq";
				atmel,aic-mux-irq-reg = <&pmc 0 0x64 0xf0f>;
			};
		};
	};

	/*
	 * An interrupt generating device that is wired to an AIC.
	 */
	dma: dma-controller@ffffec00 {
		compatible = "atmel,at91sam9g45-dma";
		reg = <0xffffec00 0x200>;
		interrupts = <21 4 5>;
	};
```
